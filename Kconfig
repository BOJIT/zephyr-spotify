## Kconfig
```kconfig
menuconfig SPOTIFY
	bool "Spotify Connect Library for Zephyr"
	help
	  Spotify Connect Library for Zephyr


rsource "lib/Kconfig"
rsource "protos/Kconfig"
```

## lib/Kconfig
```kconfig
menuconfig SPOTIFY_LIB
	bool "Zephyr Integration of Spotify Connect"
	help
	  Zephyr Integration of Spotify Connect

if SPOTIFY_LIB

endif # SPOTIFY_LIB
```
